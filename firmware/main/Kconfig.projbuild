## firmware/main/Kconfig.projbuild
```kconfig
menu "Tendair Configuration"

    orsource "$IDF_PATH/examples/common_components/env_caps/$IDF_TARGET/Kconfig.env_caps"

    config I2C_MASTER_SCL
        int "SCL GPIO Num"
        range ENV_GPIO_RANGE_MIN ENV_GPIO_OUT_RANGE_MAX
        default 4
        help
            GPIO number for I2C Master clock line.

    config I2C_MASTER_SDA
        int "SDA GPIO Num"
        range ENV_GPIO_RANGE_MIN ENV_GPIO_OUT_RANGE_MAX
        default 8
        help
            GPIO number for I2C Master data line.

    config I2C_MASTER_FREQUENCY
        int "Master Frequency"
        default 100000
        help
            I2C Speed of Master device.

    config WIFI_SSID
        string "Wifi SSID"
        default "tendair"
        help
            Wifi SSID

    config WIFI_PASS
        string "Wifi Password"
        default "tendair"
        help
            Wifi Password

    config MQTT_URI
        string "MQTT URI"
        default "mqtt://tender.home"
        help
            MQTT uri

    config MQTT_PREFIX
        string "MQTT Prefix"
        default "home/main/office"
        help
            MQTT prefix string

    config HOMEKIT_NAME
        string "HomeKit accessory name"
        default "Tendair"
        help
            Name the accessory advertises to the Home app

    config HOMEKIT_SETUP_CODE
        string "HomeKit setup code"
        default "111-22-333"
        help
            Pairing code entered in the Home app, format XXX-XX-XXX.
            Apple rejects trivial codes like 000-00-000 or 123-45-678.

    config HOMEKIT_SETUP_ID
        string "HomeKit setup ID"
        default "TNDR"
        help
            Four character setup ID (A-Z, 0-9) used in the pairing QR code

endmenu
```
